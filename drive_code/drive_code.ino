int forward = 4;    
int backward = 5;    
int left = 6;    
int right = 7;    
int val1 = 0;      // variable to store the read value
int val2 = 0;
int val3 = 0;
int val4 = 0;
int speedVal = 0;
 #include <Wire.h>
 #include <Adafruit_MotorShield.h>
 #include "utility/Adafruit_MS_PWMServoDriver.h"
 #include <SPI.h>
#include <Adafruit_GFX.h>
#include <Adafruit_SSD1306.h>
#include<Servo.h>
#define SCREEN_WIDTH 128 // OLED display width, in pixels
#define SCREEN_HEIGHT 64 // OLED display height, in pixels
#define OLED_RESET     4 // Reset pin # (or -1 if sharing Arduino reset pin)

Adafruit_SSD1306 display(SCREEN_WIDTH, SCREEN_HEIGHT, &Wire, OLED_RESET);

const unsigned char opened_eye[] PROGMEM = {
  0x00,0x00,0x00,0x00,0x00,0x00,0x00,0x00,0x00,0x00,0x00,0x00,0x00,0x00,0x00,0x00, // ................................................................................................................................
  0x00,0x00,0x00,0x00,0x00,0x00,0x00,0x00,0x00,0x00,0x00,0x00,0x00,0x00,0x00,0x00, // ................................................................................................................................
  0x00,0x00,0x00,0x00,0x00,0x00,0x00,0x00,0x00,0x00,0x00,0x00,0x00,0x00,0x00,0x00, // ................................................................................................................................
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  0x00,0x00,0x00,0x00,0x00,0x00,0x00,0x00,0x00,0x00,0x00,0x00,0x00,0x00,0x00,0x00  // ................................................................................................................................
};

const unsigned char semiopened_eye[] PROGMEM = {
  0x00,0x00,0x00,0x00,0x00,0x00,0x00,0x00,0x00,0x00,0x00,0x00,0x00,0x00,0x00,0x00, // ................................................................................................................................
  0x00,0x00,0x00,0x00,0x00,0x00,0x00,0x00,0x00,0x00,0x00,0x00,0x00,0x00,0x00,0x00, // ................................................................................................................................
  0x00,0x00,0x00,0x00,0x00,0x00,0x00,0x00,0x00,0x00,0x00,0x00,0x00,0x00,0x00,0x00, // ................................................................................................................................
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  0x00,0x00,0x00,0x00,0x00,0x00,0x00,0x00,0x00,0x00,0x00,0x00,0x00,0x00,0x00,0x00  // ................................................................................................................................
};

const unsigned char closed_eye[] PROGMEM = {
  0x00,0x00,0x00,0x00,0x00,0x00,0x00,0x00,0x00,0x00,0x00,0x00,0x00,0x00,0x00,0x00, // ................................................................................................................................
  0x00,0x00,0x00,0x00,0x00,0x00,0x00,0x00,0x00,0x00,0x00,0x00,0x00,0x00,0x00,0x00, // ................................................................................................................................
  0x00,0x00,0x00,0x00,0x00,0x00,0x00,0x00,0x00,0x00,0x00,0x00,0x00,0x00,0x00,0x00, // ................................................................................................................................
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  0x00,0x00,0x00,0x00,0x00,0x00,0x00,0x00,0x00,0x00,0x00,0x00,0x00,0x00,0x00,0x00  // ................................................................................................................................
};

const unsigned char rightLooking[] PROGMEM = {
  0x00,0x00,0x00,0x00,0x00,0x00,0x00,0x00,0x00,0x00,0x00,0x00,0x00,0x00,0x00,0x00, // ................................................................................................................................
  0x00,0x00,0x00,0x00,0x00,0x00,0x00,0x00,0x00,0x00,0x00,0x00,0x00,0x00,0x00,0x00, // ................................................................................................................................
  0x00,0x00,0x00,0x00,0x00,0x00,0x00,0x00,0x00,0x00,0x00,0x00,0x00,0x00,0x00,0x00, // ................................................................................................................................
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  0x00,0x00,0x00,0x00,0x00,0x00,0x00,0x00,0x00,0x00,0x00,0x00,0x00,0x00,0x00,0x00  // ................................................................................................................................
};

const unsigned char leftLooking[] PROGMEM = {
  0x00,0x00,0x00,0x00,0x00,0x00,0x00,0x00,0x00,0x00,0x00,0x00,0x00,0x00,0x00,0x00, // ................................................................................................................................
  0x00,0x00,0x00,0x00,0x00,0x00,0x00,0x00,0x00,0x00,0x00,0x00,0x00,0x00,0x00,0x00, // ................................................................................................................................
  0x00,0x00,0x00,0x00,0x00,0x00,0x00,0x00,0x00,0x00,0x00,0x00,0x00,0x00,0x00,0x00, // ................................................................................................................................
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  0x00,0x00,0x00,0x00,0x00,0x00,0x00,0x00,0x00,0x00,0x00,0x00,0x00,0x00,0x00,0x00  // ................................................................................................................................
};

void display_BOOT(){
  display.clearDisplay();
  display.setTextSize(2);
  display.setTextColor(WHITE);
  display.setCursor(40,15);  
  display.println("WALL_E");
  display.display();

  display.setTextSize(1);
  display.setTextColor(WHITE);
  display.setCursor(48,35);  
  display.println("BOOTING");
  display.display();
  delay(2000);
}

void blink_eye(){
  display.clearDisplay();
  display.drawBitmap(0,0,opened_eye,128,64,WHITE);
  display.display();
 
  display.clearDisplay();
  display.drawBitmap(0,0,semiopened_eye,128,64,WHITE);
  display.display();
 
  display.clearDisplay();
  display.drawBitmap(0,0,closed_eye,128,64,WHITE);
  display.display();

  display.clearDisplay();
  display.drawBitmap(0,0,semiopened_eye,128,64,WHITE);
  display.display();
  
  display.clearDisplay();
  display.drawBitmap(0,0,opened_eye,128,64,WHITE);
  display.display();
  delay(1000);
}

void lookleft(){
  display.clearDisplay();
  display.drawBitmap(0,0,opened_eye,128,64,WHITE);
  display.display();
  
  display.clearDisplay();
  display.drawBitmap(0,0,closed_eye,128,64,WHITE);
  display.display();

  display.clearDisplay();
  display.drawBitmap(0,0,leftLooking,128,64,WHITE);
  display.display();
  delay(1000);

  display.clearDisplay();
  display.drawBitmap(0,0,closed_eye,128,64,WHITE);
  display.display();
  
  display.clearDisplay();
  display.drawBitmap(0,0,opened_eye,128,64,WHITE);
  display.display();
}

void lookright(){
  display.clearDisplay();
  display.drawBitmap(0,0,opened_eye,128,64,WHITE);
  display.display();

  display.clearDisplay();
  display.drawBitmap(0,0,closed_eye,128,64,WHITE);
  display.display();

  display.clearDisplay();
  display.drawBitmap(0,0,rightLooking,128,64,WHITE);
  display.display();
  delay(1000);

  display.clearDisplay();
  display.drawBitmap(0,0,closed_eye,128,64,WHITE);
  display.display();

  display.clearDisplay();
  display.drawBitmap(0,0,opened_eye,128,64,WHITE);
  display.display();
}
void eyeMoves(){
  blink_eye();
  lookright();lookright();
  blink_eye();
  lookleft();lookleft();
}



 Adafruit_MotorShield AFMS = Adafruit_MotorShield();
 Adafruit_DCMotor *motorFRight = AFMS.getMotor(1);
 Adafruit_DCMotor *motorFLeft = AFMS.getMotor(2);
 Adafruit_DCMotor *motorBRight = AFMS.getMotor(3);
 Adafruit_DCMotor *motorBLeft = AFMS.getMotor(4);
 Servo myservo;  //neck
int pos=0 ;    



void setup() {
  myservo.attach(10);
  myservo.write(initpos);
  pinMode(forward, INPUT);    // sets the digital pin 7 as input
  pinMode(backward, INPUT);
  pinMode(left, INPUT);
  pinMode(right, INPUT);
    AFMS.begin();
  motorFRight->setSpeed(255);
  motorFLeft->setSpeed(255);
  motorBRight->setSpeed(255);
  motorBLeft->setSpeed(255);
  myservo.attach(10);

  Serial.begin(9600);
  if(!display.begin(SSD1306_SWITCHCAPVCC, 0x3C)) {
    Serial.println(F("SSD1306 allocation failed"));
  }
  display.clearDisplay();
  display_BOOT();
  eyeMoves();
  

}

void loop() {
  blink_eye();
  val1 = digitalRead(forward);   // read the input pin
  val2 = digitalRead(backward);
  val3 = digitalRead(left);
  val4 = digitalRead(right);
  
  if ((val1 == 1) && (val2 == 0) && (val3 == 0) && (val4 == 0)) { //checks if control points forward.
      motorFRight->run(FORWARD);
      motorFLeft->run(FORWARD);
      motorBRight->run(FORWARD);
      motorBLeft->run(FORWARD);
      
      
  } else if ((val1 == 0) && (val2 == 1) && (val3 == 0) && (val4 == 0)) { //checks if control points backward.
      motorFRight->run(BACKWARD);
      motorFLeft->run(BACKWARD);
      motorBRight->run(BACKWARD);
      motorBLeft->run(BACKWARD);
  } else if ((val1 == 0) && (val2 == 0) && (val3 == 1) && (val4 == 0)) { //checks if control points left.
      motorFRight->run(FORWARD);
      motorFLeft->run(BACKWARD);
      motorBRight->run(BACKWARD);
      motorBLeft->run(FORWARD);
  } else if ((val1 == 0) && (val2 == 0) && (val3 == 0) && (val4 == 1)) { //checks if control points right.
      motorFRight->run(BACKWARD);
      motorFLeft->run(FORWARD);
      motorBRight->run(FORWARD);
      motorBLeft->run(BACKWARD);
  } else {
      motorFRight->run(RELEASE);
      motorFLeft->run(RELEASE);
      motorBRight->run(RELEASE);
      motorBLeft->run(RELEASE);
      lookleft();
      for (pos = 0; pos <=psmax; pos += 10){
        myservo.write(pos);
      }
      myservo.write(initpos);
      lookright();
      for (pos = initpos; pos <=psmax; pos -= 10){
        myservo.write(pos);
      }
      eyeMoves();
      myservo.write(initpos);
  }

}
